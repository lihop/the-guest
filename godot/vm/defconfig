## godot/vm/defconfig
```kconfig
BR2_x86_64=y
BR2_KERNEL_HEADERS_4_19=y
BR2_TARGET_GENERIC_ISSUE="Department of Advanced Computronics"
BR2_TARGET_GENERIC_ROOT_PASSWD="whisper"
BR2_ROOTFS_OVERLAY="./rootfs_overlay"
BR2_ROOTFS_POST_FAKEROOT_SCRIPT="./post_build.sh"
BR2_LINUX_KERNEL=y
BR2_LINUX_KERNEL_CUSTOM_VERSION=y
BR2_LINUX_KERNEL_CUSTOM_VERSION_VALUE="4.19.239"
BR2_LINUX_KERNEL_USE_ARCH_DEFAULT_CONFIG=y
BR2_PACKAGE_BUSYBOX_SHOW_OTHERS=y
BR2_PACKAGE_ASCII_INVADERS=y
BR2_PACKAGE_OPENSSL=y
BR2_PACKAGE_PAHO_MQTT_C=y
BR2_PACKAGE_LIBFFI=y
BR2_PACKAGE_PCRE=y
BR2_PACKAGE_PCRE_UCP=y
BR2_PACKAGE_DROPBEAR=y
# BR2_PACKAGE_DROPBEAR_CLIENT is not set
BR2_PACKAGE_MOSQUITTO=y
BR2_PACKAGE_AUDIT=y
BR2_PACKAGE_HTOP=y
BR2_TARGET_ROOTFS_CPIO=y
BR2_TARGET_ROOTFS_CPIO_GZIP=y
BR2_TARGET_ROOTFS_EXT2=y
BR2_TARGET_ROOTFS_EXT2_SIZE="20M"
# BR2_TARGET_ROOTFS_TAR is not set
```
